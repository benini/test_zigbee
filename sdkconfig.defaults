## sdkconfig.defaults
```kconfig
# ========================================
# Target Configuration
# ========================================
CONFIG_IDF_TARGET="esp32c6"

# ========================================
# Flash Configuration
# ========================================
CONFIG_ESPTOOLPY_FLASHSIZE_4MB=y
CONFIG_ESPTOOLPY_FLASHSIZE="4MB"
CONFIG_ESPTOOLPY_FLASHMODE_DIO=y
CONFIG_ESPTOOLPY_FLASHFREQ_80M=y

# ========================================
# Partition Table
# ========================================
CONFIG_PARTITION_TABLE_CUSTOM=y
CONFIG_PARTITION_TABLE_CUSTOM_FILENAME="partitions.csv"
CONFIG_PARTITION_TABLE_FILENAME="partitions.csv"

# ========================================
# Bluetooth Configuration (Bluedroid)
# ========================================
CONFIG_BT_ENABLED=y
CONFIG_BT_BLUEDROID_ENABLED=y
CONFIG_BT_BLE_ENABLED=y
CONFIG_BT_CONTROLLER_ENABLED=y
CONFIG_BT_BLE_42_FEATURES_SUPPORTED=y
CONFIG_BT_BLE_50_FEATURES_SUPPORTED=n
CONFIG_BTDM_CTRL_MODE_BLE_ONLY=y
CONFIG_BT_GATTS_ENABLE=y
CONFIG_BT_GATT_MAX_SR_PROFILES=2
CONFIG_BT_BLE_DYNAMIC_ENV_MEMORY=n
CONFIG_BT_BLUEDROID_PINNED_TO_CORE=0

# BLE Device Name
CONFIG_BT_NIMBLE_ENABLED=n

# ========================================
# Zigbee Configuration
# ========================================
CONFIG_ZB_ENABLED=y
CONFIG_ZB_ZCZR=y
CONFIG_ZB_COORDINATOR_ROLE=y
CONFIG_ZB_RADIO_NATIVE=y

# Zigbee Storage
CONFIG_ZB_ZED_STORAGE_MODE_NONE=n
CONFIG_ZB_ZCL_STORE_NVRAM_ENABLE=y

# ========================================
# IEEE 802.15.4 Radio
# ========================================
CONFIG_IEEE802154_ENABLED=y

# ========================================
# Software Coexistence (BLE + Zigbee)
# ========================================
CONFIG_ESP_COEX_SW_COEXIST_ENABLE=y
CONFIG_ESP_COEX_EXTERNAL_COEXIST_ENABLE=n

# ========================================
# FreeRTOS Configuration
# ========================================
CONFIG_FREERTOS_HZ=1000
CONFIG_FREERTOS_UNICORE=y

# ========================================
# Log Level
# ========================================
CONFIG_LOG_DEFAULT_LEVEL_INFO=y
CONFIG_LOG_DEFAULT_LEVEL=3
CONFIG_LOG_MAXIMUM_LEVEL=4

# ========================================
# NVS Configuration
# ========================================
CONFIG_NVS_ENCRYPTION=n

# ========================================
# System Configuration
# ========================================
CONFIG_ESP_MAIN_TASK_STACK_SIZE=4096
CONFIG_ESP_SYSTEM_EVENT_TASK_STACK_SIZE=2560

# ========================================
# Heap Configuration
# ========================================
CONFIG_HEAP_POISONING_DISABLED=y
```
